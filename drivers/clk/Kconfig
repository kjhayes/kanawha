## drivers/clk/Kconfig
```kconfig
config ACPI_PM_TIMER_CLK
    tristate "ACPI PM Timer Clock"
    default y
    depends on ACPI
    help
      Support using the ACPI PM Timer as a clock device
```

## kernel/drivers/Kconfig
```kconfig
menu "Block Devices"
source "kernel/drivers/blk/Kconfig"
endmenu

menu "Clock Devices"
source "kernel/drivers/clk/Kconfig"
endmenu

menu "Serial Devices"
source "kernel/drivers/serial/Kconfig"
endmenu

source "kernel/drivers/pci/Kconfig"
source "kernel/drivers/ps2/Kconfig"
source "kernel/drivers/qemu/Kconfig"
```

## kernel/drivers/ps2/Kconfig
```kconfig
config PS2_8042
    tristate "8042 PS/2 Controller"
    depends on PORT_IO && PS2
    default y

config PS2_KBD
    tristate "PS/2 Keyboard Driver"
    depends on PS2
    default y
```

## kernel/drivers/serial/8250/Kconfig
```kconfig
config PC_COM_8250
    tristate "PC COM Serial Port(s)"
    default y
    depends on SERIAL_8250 && X64
    help
      Driver for platform serial ports on x64
```

## kernel/fs/sys/Kconfig
```kconfig
menu "sysfs Options"

config SYSFS_PCI
    tristate "sysfs PCI"
    default n
    depends on PCI
    help
      Include a "pci" sysfs directory

endmenu
```

## kernel/mb2/Kconfig
```kconfig
config MULTIBOOT2_MODULES
    bool "Multiboot2 Module Support"
    default y
    depends on MULTIBOOT2
    help
      Look for and protect Mutliboot2 Modules

config MULTIBOOT2_RAMFILE
    bool "Multiboot2 ramfile Support"
    default y
    depends on MULTIBOOT2
    help
      Look for and initialize Multiboot2 Modules as ramfiles

config MULTIBOOT2_ACPI
    bool "Multiboot2 ACPI Info Support"
    default y
    depends on ACPI && MULTIBOOT2
    help
      Look for ACPI information in Mutliboot2 structures
```
