## kernel/drivers/pci/Kconfig
```kconfig
config PCI
    tristate "PCI Support"
    default y
    help
      Base PCI Bus Support

config PCI_ASSUME_CONTIGUOUS_DEVICES
    bool "Assume Contiguous Devices"
    default n
    help
      Assume PCI devices are contiguous within a bus, this is not required, but may speed up boot times by avoiding enumerating every possible bus:device:func.

menu "PCI Configuration Space Access Mechanisms"
depends on PCI

config PCI_PORT_CAM
    bool "Port Configuration Access"
    depends on PORT_IO && PCI
    default y
    help
      Assume a PCI domain exists which can be accessed using the ports 0xCF8 and 0xCFC

endmenu
```

## kernel/drivers/qemu/Kconfig
```kconfig
menu "Qemu Specific Devices"

config QEMU_PCI_TEST_DEVICE
    tristate "PCI Test Device"
    default n
    depends on PCI
    help
      Include a driver for the QEMU PCI test device

config QEMU_PCI_EDU_DEVICE
    tristate "PCI EDU Device"
    default n
    depends on PCI
    help
      Include a driver for the QEMU PCI EDU device

endmenu
```

## kernel/drivers/rand/Kconfig
```kconfig
config VIRTIO_RNG
    tristate "Virtio RNG Source"
    depends on VIRTIO
    default n
```

## kernel/drivers/serial/Kconfig
```kconfig
config SERIAL_8250
    tristate "8250 Based Serial UART(s)"
    default y
    help
      Framework to support 8250-based serial UART devices

config DEBUG_VGA_SERIAL
    bool "Debug VGA Pseudo-Terminal"
    default n
    depends on X64 && DEBUGGING && !X64_BOOT_VGA
    help
      Place a simple pseudo terminal on the platform VGA serial device

config VIRTIO_CONSOLE
    bool "Virtio Console"
    default n
    depends on VIRTIO

config QEMU_SERIAL
    bool "QEMU PCI Serial"
    default n
    depends on PCI

source "kernel/drivers/serial/8250/Kconfig"
```

## kernel/drivers/vga/Kconfig
```kconfig
config VGA_RAMFILE
    bool "VGA Framebuffer Ramfile"
    default y
    depends on X64 && DEBUGGING && !X64_BOOT_VGA
    help
      Place a ramfile on top of the x64 platform vga framebuffer

config DEBUG_VGA_SERIAL
    bool "Debug VGA Pseudo-Terminal"
    default n
    depends on X64 && DEBUGGING && !X64_BOOT_VGA && !VGA_RAMFILE
    help
      Place a simple pseudo terminal on the platform VGA serial device
```

## kernel/kmalloc/Kconfig
```kconfig
choice
    prompt "Kmalloc Backend"
    default KMALLOC_KHEAP
    config KMALLOC_KHEAP
        bool "Heap Allocator"
#    config KMALLOC_DEBUG_PAGED
#        bool "Debug Paged Allocator"
#        depends on DEBUGGING
endchoice

config KMALLOC_TRACK_CALLSITES
    bool "Track Callsites"
    default n

config KMALLOC_TRACK_CALLSITES_LOG_AT_LAUNCH
    bool "Log Tracked Callsites at Launch"
    default n
    depends on KMALLOC_TRACK_CALLSITES

config KMALLOC_TRACK_CALLSITES_LOG_PERIODIC
    bool "Log Tracked Callsites Periodically"
    default n
    depends on KMALLOC_TRACK_CALLSITES

config KMALLOC_TRACK_CALLSITES_SEC_PERIOD
    int "Log Tracked Callsites Period (sec)"
    default 30
    depends on KMALLOC_TRACK_CALLSITES_LOG_PERIODIC

config DEBUG_KHEAP_TOUCH
    bool "Touch kheap Allocations On Alloc and Free"
    depends on DEBUGGING
    default n
    help
      By memset-ing out all allocations made using the kheap allocators both
      during allocation and freeing, then we can trap the allocation and freeing
      with gdb watchpoints, making tracking down double-free errors easier.

config DEBUG_KMALLOC_BITMAP
    bool "Track kmalloc Allocations in a Global Bitmap"
    depends on DEBUGGING && KMALLOC_KHEAP
    default n
    help
      Track every byte in the kmalloc heap with a large bitmap of allocations,
      this is really justed used for debugging the underlying allocator implemention,
      though it could be used to catch double free errors
      The static bitmap uses one bit per byte in the virtual size of the heap,
      so a small value of CONFIG_HEAP_SIZE_ORDER must be used.
```

## kernel/linux/Kconfig
```kconfig
config LINUX_DEVICETREE_CHOSEN
    bool "Process Device Tree /chosen Node"
    depends on DEVICETREE
    default y
```

## kernel/sched/Kconfig
```kconfig
config DEFAULT_SCHEDULER
    string "Default Scheduler"
    default "rr_sched"
    help
      Name of the default scheduler to assign at boot (or "" if no default scheduler should be assigned)

config ROUND_ROBIN_SCHED
    tristate "Round Robin Scheduler (rr_sched)"
    default y
    help
      Round Robin Scheduler "rr_sched"

config ROUND_ROBIN_SCHED_TIMESLICE_MS
    int "Round Robin Timeslice (ms)"
    default 10
    depends on ROUND_ROBIN_SCHED
    help
      Round Robin Scheduler Timeslice length in milliseconds
```

## kernel/syscall/Kconfig
```kconfig
config DEBUG_SYSCALL_OPEN
    bool "Debug open"
    depends on DEBUGGING
    default n
    help
      Log the file-names of each file opened by a process.

config DEBUG_SYSCALL_EXIT
    bool "Debug exit"
    depends on DEBUGGING
    default n
    help
      Log process ID and exitcode on exit

config DEBUG_SYSCALL_WRITE
    bool "Debug write"
    depends on DEBUGGING
    default n
    help
      Log info about write system calls

config DEBUG_SYSCALL_READ
    bool "Debug read"
    depends on DEBUGGING
    default n
    help
      Log info about read system calls

config DEBUG_SYSCALL_FLUSH
    bool "Debug flush"
    depends on DEBUGGING
    default n

config DEBUG_SYSCALL_EXEC
    bool "Debug exec"
    depends on DEBUGGING
    default n

config DEBUG_SYSCALL_ENVIRON
    bool "Debug environ"
    depends on DEBUGGING
    default n
    help
      Log info about environ system calls

config DEBUG_SYSCALL_MMAP
    bool "Debug mmap"
    depends on DEBUGGING
    default n
    help
      Log info about each mmap syscall

config DEBUG_SYSCALL_CHWDIR
    bool "Debug chwdir"
    depends on DEBUGGING
    default n

config DEBUG_SYSCALL_CHROOT
    bool "Debug chroot"
    depends on DEBUGGING
    default n

config DEBUG_SYSCALL_DIRATTR
    bool "Debug dirattr"
    depends on DEBUGGING
    default n

config DEBUG_SYSCALL_DIRBEGIN
    bool "Debug dirbegin"
    depends on DEBUGGING
    default n

config DEBUG_SYSCALL_DIRNAME
    bool "Debug dirname"
    depends on DEBUGGING
    default n

config DEBUG_SYSCALL_DIRNEXT
    bool "Debug dirnext"
    depends on DEBUGGING
    default n

config DEBUG_SYSCALL_MKFILE
    bool "Debug mkfile"
    depends on DEBUGGING
    default n

config DEBUG_SYSCALL_UNLINK
    bool "Debug unlink"
    depends on DEBUGGING
    default n

config DEBUG_SYSCALL_POLL
    bool "Debug poll"
    depends on DEBUGGING
    default n

config DEBUG_SYSCALL_SIGSEND
    bool "Debug sigsend"
    depends on DEBUGGING
    default n
```

## kernel/sysfs/Kconfig
```kconfig
config PROCFS
    bool "procfs"
    default y
    help
      Include the "proc" sysfs directory

config SYSFS_PCI
    tristate "sysfs PCI"
    default n
    depends on PCI
    help
      Include a "pci" sysfs directory
```

## libc/Kconfig
```kconfig
choice
    prompt "malloc Allocator"
    default MMAP_ALLOC
    config MMAP_ALLOC
        bool "MMAP"
endchoice
```

## setups/arm64/defconfig
```kconfig
# CONFIG_X64 is not set
# CONFIG_RISCV64 is not set
CONFIG_ARM64=y
# CONFIG_CLANG is not set
CONFIG_GCC=y
CONFIG_OPT_FLAGS="-O3"
CONFIG_MAX_CPUS=64
CONFIG_UNHANDLED_IRQ_PANIC=y
# CONFIG_UNHANDLED_IRQ_WARN is not set
# CONFIG_UNHANDLED_IRQ_IGNORE is not set

#
# Kernel Memory Layout
#
CONFIG_HEAP_ALIGN_ORDER=30
CONFIG_HEAP_SIZE_ORDER=24
CONFIG_HEAP_GROWTH_ORDER=21
CONFIG_PERCPU_HEAP_SIZE_ORDER=32
CONFIG_MMIO_RESERVE_SIZE_ORDER=32
# end of Kernel Memory Layout

#
# Time Options
#
CONFIG_PERIODIC_RESOLUTION_MS=10
CONFIG_TIMESTAMP_RESOLUTION_MS=10
# end of Time Options

#
# Firmware Interfaces
#
CONFIG_ACPI=y

#
# ACPI Options
#
CONFIG_ACPI_SYSFS=y
# end of ACPI Options

CONFIG_DEVICETREE=y
CONFIG_DEVICETREE_REQUIRED=y
# end of Firmware Interfaces

CONFIG_INIT_PROCESS_PATH="init"
CONFIG_INIT_PROCESS_ARGS=""
CONFIG_INITIAL_FS_BACKEND_SYSFS_DIR="ramfile"
CONFIG_INITIAL_FS_BACKEND_FILE_NAME="initrd"
CONFIG_INITIAL_FS_FILESYSTEM="cpio"

#
# printk Options
#
CONFIG_KLOG_FRAMESIZE=0x1000
CONFIG_KLOG_BOOT_FRAMES=0x80
CONFIG_PRINTK_BUFFER_SIZE=0x1000
CONFIG_PANIC_BUFFER_SIZE=0x1000
CONFIG_PRINTK_MAX_HANDLERS=8
CONFIG_LOG_INIT_STAGES=y

#
# Log Devices on Launch
#
CONFIG_LOG_TERMDEV_REGISTRY_ON_LAUNCH=y
CONFIG_LOG_BLKDEV_REGISTRY_ON_LAUNCH=y
CONFIG_LOG_CLKDEV_REGISTRY_ON_LAUNCH=y
CONFIG_LOG_FBDEV_REGISTRY_ON_LAUNCH=y
CONFIG_LOG_IRQDEV_REGISTRY_ON_LAUNCH=y
CONFIG_LOG_INPUTDEV_REGISTRY_ON_LAUNCH=y
CONFIG_LOG_RANDDEV_REGISTRY_ON_LAUNCH=y
CONFIG_LOG_SNDDEV_REGISTRY_ON_LAUNCH=y
CONFIG_LOG_ETHDEV_REGISTRY_ON_LAUNCH=y
CONFIG_LOG_IPV4DEV_REGISTRY_ON_LAUNCH=y
# end of Log Devices on Launch
# end of printk Options

#
# Debug Options
#
CONFIG_DEBUGGING=y
CONFIG_DEBUG_SYMBOLS=y
CONFIG_DEBUG_ASSERTIONS=y
# CONFIG_PERCPU_DEBUG_ASSERTIONS is not set
CONFIG_DISABLE_NORETURN_ATTRIBUTE=y

#
# Kernel Address Checking
#
CONFIG_DEBUG_HIGHER_HALF_KERNEL_ADDRESSES=y
# end of Kernel Address Checking

# CONFIG_DEBUG_BUDDY_ALLOC is not set
# CONFIG_DEBUG_INIT_STAGES is not set
# CONFIG_DEBUG_DUMP_THREADS_PERIODICALLY is not set
# CONFIG_DEBUG_DUMP_PERF_METRICS_PERIODICALLY is not set
# CONFIG_DEBUG_LOG_THREAD_STATE_CHANGES is not set
CONFIG_DEBUG_TRACK_PROCESS_EXEC=y
CONFIG_DEBUG_PROCESS_TERMINATION=y

#
# Strace Options
#
# CONFIG_STRACE_LOG_SYSCALL_BEGIN is not set
# CONFIG_STRACE_LOG_SYSCALL_END is not set
# CONFIG_STRACE_LOG_SIGNALS is not set
# CONFIG_STRACE_TIME_SYSCALLS is not set
# end of Strace Options

#
# syscall Debugging
#
# CONFIG_DEBUG_SYSCALL_OPEN is not set
# CONFIG_DEBUG_SYSCALL_EXIT is not set
# CONFIG_DEBUG_SYSCALL_WRITE is not set
# CONFIG_DEBUG_SYSCALL_READ is not set
# CONFIG_DEBUG_SYSCALL_FLUSH is not set
# CONFIG_DEBUG_SYSCALL_EXEC is not set
# CONFIG_DEBUG_SYSCALL_ENVIRON is not set
# CONFIG_DEBUG_SYSCALL_MMAP is not set
# CONFIG_DEBUG_SYSCALL_REAP is not set
# CONFIG_DEBUG_SYSCALL_FACCESS is not set
# CONFIG_DEBUG_SYSCALL_CHWDIR is not set
# CONFIG_DEBUG_SYSCALL_CHROOT is not set
# CONFIG_DEBUG_SYSCALL_DIRATTR is not set
# CONFIG_DEBUG_SYSCALL_DIRBEGIN is not set
# CONFIG_DEBUG_SYSCALL_DIRNAME is not set
# CONFIG_DEBUG_SYSCALL_DIRNEXT is not set
# CONFIG_DEBUG_SYSCALL_MKFILE is not set
# CONFIG_DEBUG_SYSCALL_UNLINK is not set
# CONFIG_DEBUG_SYSCALL_PIPE is not set
# CONFIG_DEBUG_SYSCALL_POLL is not set
# CONFIG_DEBUG_SYSCALL_SIGMOD is not set
# CONFIG_DEBUG_SYSCALL_SIGINFO is not set
# CONFIG_DEBUG_SYSCALL_SIGSEND is not set
# CONFIG_DEBUG_SYSCALL_RID is not set
# end of syscall Debugging
# end of Debug Options

#
# kmalloc Options
#
CONFIG_KMALLOC_KHEAP=y
# CONFIG_KMALLOC_TRACK_CALLSITES is not set
# CONFIG_DEBUG_KHEAP_TOUCH is not set
# CONFIG_DEBUG_KMALLOC_BITMAP is not set
# end of kmalloc Options

#
# Filesystem Options
#

#
# sysfs Options
#
CONFIG_PROCFS=y
CONFIG_SYSFS_PCI=y
# end of sysfs Options

#
# Schedulers
#
CONFIG_DEFAULT_SCHEDULER="rr_sched"
CONFIG_ROUND_ROBIN_SCHED=y
CONFIG_ROUND_ROBIN_SCHED_TIMESLICE_MS=10
# end of Schedulers

#
# Misc. Options
#

#
# Device Tree
#

#
# Multiboot2 Options
#
# end of Multiboot2 Options

CONFIG_DISPLAY_LOGO_ON_FRAMEBUFFER_MODESET=y
# end of Misc. Options

CONFIG_LOGO_DATA=y

#
# ARM64 Options
#
CONFIG_ARM64_LINKED_PHYS_BASE=0x40100000
CONFIG_ARM64_KERNEL_VIRTUAL_BASE=0xFFFFFFC000000000
CONFIG_ARM64_BOOT_STACK_SIZE=0x1000
# end of ARM64 Options

#
# Drivers
#

#
# Block Devices
#
CONFIG_VIRTIO_BLK=y
CONFIG_NVME=y
# end of Block Devices

#
# Network Devices
#
CONFIG_VIRTIO_NET=y
# end of Network Devices

#
# Filesystems
#
CONFIG_MBR=y
CONFIG_CPIO_FS=y
CONFIG_EXT2_FS=y
CONFIG_RAMFS=y
CONFIG_FAT=y
# end of Filesystems

#
# Clock Devices
#
CONFIG_ACPI_PM_TIMER_CLK=y
# end of Clock Devices

#
# IRQ Devices
#
# end of IRQ Devices

#
# Terminal Devices
#
CONFIG_SERIAL_8250=y
# CONFIG_QEMU_SERIAL is not set
CONFIG_DEVTREE_8250=y
# end of Terminal Devices

#
# Framebuffer Devices
#
CONFIG_VIRTIO_GPU_FB=y
# end of Framebuffer Devices

#
# Randomness Sources
#
CONFIG_VIRTIO_RNG=y
# end of Randomness Sources

#
# Sound Devices
#
CONFIG_VIRTIO_SND=y
# end of Sound Devices

#
# PCI Options
#
CONFIG_PCI=y
# CONFIG_PCI_ASSUME_CONTIGUOUS_DEVICES is not set
CONFIG_PCI_ALLOC_UNINITIALIZED_MMIO_BARS=y

#
# PCI Configuration Space Access Mechanisms
#
CONFIG_PCI_MMIO_ECAM=y
CONFIG_PCI_DEVTREE=y
CONFIG_PCIE_ACPI_MCFG=y
# end of PCI Configuration Space Access Mechanisms

# CONFIG_DEBUG_LOG_PCI_BAR_ACCESSES is not set
# CONFIG_DEBUG_PCI_BAR_ACCESSES is not set
# end of PCI Options

#
# USB Options
#
# end of USB Options

CONFIG_PS2=y

#
# PS/2 Devices
#
CONFIG_PS2_KBD=y
# end of PS/2 Devices

#
# Qemu Specific Devices
#
# CONFIG_QEMU_PCI_TEST_DEVICE is not set
# CONFIG_QEMU_PCI_EDU_DEVICE is not set
# end of Qemu Specific Devices

CONFIG_VIRTIO=y

#
# Virtio Transports
#
CONFIG_VIRTIO_PCI=y
# end of Virtio Transports

#
# Linux Compatibility
#
CONFIG_LINUX_DEVICETREE_CHOSEN=y
# end of Linux Compatibility
# end of Drivers

#
# Userspace Options
#
CONFIG_USER_BUILD_C_RUNTIME=y
CONFIG_USER_BUILD_LIBC=y
CONFIG_USER_BUILD_KFB=y
# end of Userspace Options

# CONFIG_WIP is not set
CONFIG_KANAWHA=y
CONFIG_MODULES=y
CONFIG_SMP=y
```

## setups/riscv64/defconfig
```kconfig
# CONFIG_X64 is not set
CONFIG_RISCV64=y
CONFIG_GCC=y
CONFIG_GCC_CROSS_COMPILE_PREFIX="riscv64-kanawha-"
CONFIG_OPT_FLAGS="-O3"
CONFIG_KANAWHA_INCLUDE_PATH="../kanawha/include"

#
# Libc Options
#
CONFIG_ELK=y
```
