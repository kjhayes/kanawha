## kernel/sysfs/Kconfig
```kconfig
config PROCFS
    bool "procfs"
    default y
    help
      Include the "proc" sysfs directory

config SYSFS_PCI
    bool "PCI sysfs"
    default y
    depends on PCI
    help
      Include a "pci" sysfs directory
```
