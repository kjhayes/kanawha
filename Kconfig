## kernel/Kconfig
```kconfig
config INIT_PROCESS_PATH
    string "init Path"
    default "/init"
    help
      Path to search for the init process ELF executable

config INIT_PROCESS_ARGS
    string "init Arguments"
    default ""
    help
      Value to append to "INIT_PROCESS_PATH" to pass as the "ARGV" environment variable to on entry to the init process.

config INITIAL_FS_BACKEND_SYSFS_DIR
    string "Initial FS Backing sysfs Directory"
    default "ramfile"

config INITIAL_FS_BACKEND_FILE_NAME
    string "Initial FS Backing File Name"
    default "initrd"

config INITIAL_FS_FILESYSTEM
    string "Root FS Filesystem"
    default "cpio"
    help
      Filesystem type to try mounting the root fs as.

menu "printk Options"

config KLOG_FRAMESIZE
    hex "klog Framesize"
    default 0x1000
config KLOG_BOOT_FRAMES
    hex "klog Boot Frames"
    default 4
    help
      The number of frames statically allocated for klog during boot.
config PRINTK_BUFFER_SIZE
    hex "printk Buffer Size"
    default 0x1000
    help
      Size of the printk static buffer in bytes

config PANIC_BUFFER_SIZE
    hex "panic Buffer Size"
    default 0x1000
    help
      Size of the panic static buffer in bytes

config PRINTK_MAX_HANDLERS
    int "printk Maximum Handlers"
    default 8
    help
      Maximum number of printk handlers which can be registered

config LOG_INIT_STAGES
    bool "Log all init handlers using printk"
    default n
    help
      Print out a message with the start and end of each init function.

menu "Log Devices on Launch"
config LOG_TERMDEV_REGISTRY_ON_LAUNCH
    bool "Log termdev Registry"
    default n
config LOG_BLKDEV_REGISTRY_ON_LAUNCH
    bool "Log blkdev Registry"
    default n
config LOG_CLKDEV_REGISTRY_ON_LAUNCH
    bool "Log clkdev Registry"
    default n
config LOG_FBDEV_REGISTRY_ON_LAUNCH
    bool "Log fbdev Registry"
    default n
config LOG_IRQDEV_REGISTRY_ON_LAUNCH
    bool "Log irqdev Registry"
    default n
config LOG_INPUTDEV_REGISTRY_ON_LAUNCH
    bool "Log inputdev Registry"
    default n
config LOG_RANDDEV_REGISTRY_ON_LAUNCH
    bool "Log randdev Registry"
    default n
config LOG_SNDDEV_REGISTRY_ON_LAUNCH
    bool "Log snddev Registry"
    default n
config LOG_ETHDEV_REGISTRY_ON_LAUNCH
    bool "Log ethdev Registry"
    default n
config LOG_IPV4DEV_REGISTRY_ON_LAUNCH
    bool "Log ipv4dev Registry"
    default n
endmenu

endmenu

menu "Debug Options"
config DEBUGGING
    bool "Enable Debugging Options"
    default n
    help
      Root Debugging Config Option

config DEBUG_SYMBOLS
    bool "Include Debug Symbols"
    depends on DEBUGGING
    default y
    help
      Include debug symbols in kernel binary

config DEBUG_ASSERTIONS
    bool "Enable Debug Assertions"
    depends on DEBUGGING
    default y
    help
      Enable DEBUG_ASSERT Checking

config PERCPU_DEBUG_ASSERTIONS
    bool "Enable percpu Variable Debug Assertions"
    depends on DEBUGGING && DEBUG_ASSERTIONS
    default n
    help
      Enable the DEBUG_ASSERT_PERCPU_VALID assertion, which includes a percpu checksum variable
      used to make sure that the percpu variable subsystem is working correctly.

config DISABLE_NORETURN_ATTRIBUTE
    bool "Disable __noreturn Attribute"
    depends on DEBUGGING
    default y
    help
      Disable the __noreturn attribute so that the compiler correctly generates backtraces when debugging.

menu "Kernel Address Checking"
config DEBUG_HIGHER_HALF_KERNEL_ADDRESSES
    bool "Higher Half Addresses"
    depends on DEBUGGING
    default y
    help
      Check that pointers are in the higher half of memory during KERNEL_ADDR checks
endmenu

config DEBUG_BUDDY_ALLOC
    bool "Debug Buddy Allocators"
    depends on DEBUGGING
    default n
    help
      Debug kernel Buddy Allocators

config DEBUG_INIT_STAGES
    bool "Debug init Stages Framework"
    depends on DEBUGGING
    default n
    help
      Debug the init Stages Framework

config DEBUG_DUMP_THREADS_PERIODICALLY
    bool "Dump Thread Info Periodically"
    depends on DEBUGGING
    default n

config DEBUG_DUMP_THREADS_PERIODICALLY_PERIOD
    int "Dump Thread Period (sec)"
    depends on DEBUG_DUMP_THREADS_PERIODICALLY
    default 60

config DEBUG_TRACK_PROCESS_EXEC
    bool "Track Process Exec Path"
    depends on DEBUGGING
    default y
    help
      Track the path string as a process uses the "exec" system call

config DEBUG_X64_PEDANTIC_VERIFY_PAGE_TABLES
    bool "Verify x64 Page Tables Pedantically"
    depends on X64 && DEBUGGING
    default n
    help
      Add checks to verify x64 page tables any time that one is manipulated.
      This helps find issues with the page table handling code on x64 effectively,
      but can drastically slow down the kernel.

config DEBUG_PROCESS_TERMINATION
    bool "Log Process Termination"
    depends on DEBUGGING
    default n

menu "Strace Options"

config STRACE_LOG_SYSCALL_BEGIN
    bool "Debug Log All syscall Beginnings"
    depends on DEBUGGING
    default n
    help
      Log the beginning of each syscall (process ID and syscall ID)

config STRACE_LOG_SYSCALL_END
    bool "Debug Log All syscall Completions"
    depends on DEBUGGING
    default n
    help
      Log the ending of each syscall, useful for debugging kernel bugs during the handling of a specific syscall

config STRACE_LOG_SIGNALS
    bool "Debug Log signals"
    depends on DEBUGGING
    default n

config STRACE_TIME_SYSCALLS
    bool "Time syscall Execution"
    depends on DEBUGGING
    default n

endmenu

menu "syscall Debugging"
source "kernel/syscall/Kconfig"
endmenu

endmenu

menu "kmalloc Options"
source "kernel/kmalloc/Kconfig"
endmenu

menu "Filesystem Options"
source "kernel/fs/Kconfig"
endmenu

menu "sysfs Options"
source "kernel/sysfs/Kconfig"
endmenu

menu "Schedulers"
source "kernel/sched/Kconfig"
endmenu

menu "Misc. Options"

menu "Device Tree"
source "kernel/devtree/Kconfig"
endmenu

config MULTIBOOT2
    tristate "Multiboot2 Support"
    default n
    depends on X64 || MIPS
    help
      Kernel support for the multiboot2 specification

menu "Multiboot2 Options"
source "kernel/mb2/Kconfig"
endmenu

config DISPLAY_LOGO_ON_FRAMEBUFFER_MODESET
    bool "Display Logo on Framebuffer Modeset"
    default y
    select LOGO_DATA

endmenu

config LOGO_DATA
    def_bool n
    help
        Should data for the kanawha logo be compiled into the kernel?
	(Should not be chosen explicitly)
```

## kernel/acpi/Kconfig
```kconfig
config ACPI_INTERPRET_AML
  bool "ACPI AML Interpreter"
  default y
  depends on ACPI && WIP

config ACPI_SYSFS
  bool "ACPI sysfs"
  default y
  depends on ACPI
  help
    Add a sysfs mount representing the ACPI tables registered with the kernel.
```

## kernel/drivers/irq/Kconfig
```kconfig
config SIFIVE_PLIC
    tristate "SiFive PLIC"
    default y
    depends on DEVICETREE && RISCV64
    help
      Include a driver for the SiFive PLIC Interrupt Controller
```
