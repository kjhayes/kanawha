## Kconfig
```kconfig
choice
  prompt "Architecture"
  default X64
  config X64
    bool "x86_64"
    select PORT_IO
    select ACPI
    select ACPI_REQUIRED
  config RISCV64
    bool "RISCV64"
    select DEVICETREE
    select DEVICETREE_REQUIRED
endchoice

choice
  prompt "Toolchain"
  default CLANG
  config CLANG
    bool "Clang/LLVM"
  config GCC
    bool "GCC"
    select TOOLCHAIN_SUPPORTS_BITWISE_ATTRIBUTE
endchoice

config OPT_FLAGS
  string "Compiler Optimization Flags"
  default -O3
  help
    Optimization flags to pass to the compiler

config MAX_CPUS
  int "Max CPU(s)"
  default 1
  help
    Maximum number of CPU(s) in the system.

choice
  prompt "Unhandled Interrupt Reaction"
  default UNHANDLED_IRQ_PANIC
  config UNHANDLED_IRQ_PANIC
    bool "Panic"
  config UNHANDLED_IRQ_WARN
    bool "Warn"
  config UNHANDLED_IRQ_IGNORE
    bool "Ignore"
endchoice

menu "Kernel Memory Layout"

config HEAP_ALIGN_ORDER
  int "Heap Alignment Order"
  default 30
  help
    Order which the kernel heap needs to be aligned to.

config HEAP_SIZE_ORDER
  int "Heap Virtual Size Order"
  default 39
  help
    Order which the kernel heap's virtual memory region should be sized as.

config HEAP_GROWTH_ORDER
  int "Heap Growth Order"
  default 21
  help
    Order of increments to grow the kernel heaps at.

config PERCPU_HEAP_SIZE_ORDER
  int "percpu Heap Virtual Size Order"
  default 32
  help
    Order which each percpu heap's virtual memory region should be sized as.

config MMIO_RESERVE_SIZE_ORDER
  int "Reserved MMIO Virtual Size Order"
  default 32
  help
    Order which reserved MMIO virtual memory region should be sized as.
endmenu

menu "Time Options"
config PERIODIC_RESOLUTION_MS
  int "Periodic Event Resolution (ms)"
  default 10
  help
    Minimum resolution of the "periodic" events subsystem.
    The period of all periodic events will be rounded to the nearest non-zero
    multiple of this number. A higher value will result in fewer timer interrupts,
    but worse latency/longer sleep times than requested.
config TIMESTAMP_RESOLUTION_MS
  int "Timestamp Resolution (ms)"
  default 10
  help
    Resolution of the system "current_timestamp" found in "kanawha/time.h".
    At the moment, this value must be a multiple of PERIODIC_RESOLUTION_MS.
endmenu

menu "Firmware Interfaces"
config ACPI
  bool "ACPI"
  default n
  help
    Include support for the Advanced Power and Configuration Interface (ACPI)

config ACPI_REQUIRED
  bool "ACPI Required"
  default n
  depends on ACPI
  help
    Should the kernel panic if ACPI tables cannot be found?

config DEVICETREE
  bool "Device Tree"
  default n
  help
    Include support for the OpenFirmware Device Tree interface

config DEVICETREE_REQUIRED
  bool "Device Tree Required"
  default n
  help
    Should the kernel panic if a device tree cannot be found?

endmenu

source "kernel/Kconfig"
source "arch/Kconfig"

# Used to check that a .config exists
config KANAWHA
    def_bool y
config MODULES
    def_bool y
config PORT_IO
    def_bool n
config SMP
    def_bool y
    depends on MAX_CPUS > 1

# Toolchain Support
config TOOLCHAIN_SUPPORTS_BITWISE_ATTRIBUTE
    def_bool n
```

## arch/Kconfig
```kconfig
source "arch/x64/Kconfig"
source "arch/riscv64/Kconfig"
source "arch/arm64/Kconfig"
```

## arch/arm64/Kconfig
```kconfig
menu "ARM64 Options"
    depends on ARM64

choice
  prompt "Boot Protocol"
  default ARM64_BAREMETAL_BOOT
  config ARM64_BAREMETAL_BOOT
      bool "Baremetal"
endchoice

config ARM64_BAREMETAL_BOOT_DEVICE_TREE_PHYS_ADDR
  hex "Baremetal Device Tree Physical Address"
  depends on ARM64_BAREMETAL_BOOT
  default 0x0

config ARM64_LINKED_PHYS_BASE
  hex "Physical Base to Use When Linking"
  default 0x10000
  help
    What physical base we should link the kernel to assume.
    This value should also be greater than 0x0 to provide
    space for the ELF program headers section

config ARM64_KERNEL_VIRTUAL_BASE
  hex "Virtual Address of the Kernel"
  default 0xFFFFFFC000010000
  help
    What virtual address to link the kernel at

config ARM64_BOOT_STACK_SIZE
  hex "Boot Stack Size"
  default 0x1000
  help
    How big should the statically allocated
    kernel boot stack be?

config ARM64_BOOT_LOWMEM_IDENTITY_MAP_ORDER
  int "Boot Low Memory Identity Map Order"
  default 36

config ARM64_BOOT_HIGHMEM_KERNEL_MAP_ORDER
  int "Boot High Memory Kernel Map Order"
  default 36

endmenu
```

## arch/riscv64/Kconfig
```kconfig
menu "RISCV-64 Options"
    depends on RISCV64

config RISCV64_LINKED_PHYS_BASE
  hex "Physical Base to Use When Linking"
  default 0x10000
  help
    What physical base we should link the kernel to assume.
    The kernel may actually be loaded at a different address, but because
    we compile with the mcmodel=medany this is not a problem aside from making the transition
    to high-mem early on in the boot process.

    This value should also be greater than 0x0 to provide space for the ELF program headers section

config RISCV64_KERNEL_VIRTUAL_BASE
  hex "Virtual Address of the Kernel"
  default 0xFFFFFFC000000000
  help
    What virtual address to link the kernel at

config RISCV64_BOOT_KERNEL_MAP_ORDER
  int "Boot Kernel Mapping Order"
  default 22
  help
    Order of the boot-time kernel high-mem mapping

config RISCV64_IDENTITY_MAP_ORDER
  int "Identity Map Order"
  default 32
  help
    Order of the kernel identity map

config RISCV64_BOOT_STACK_SIZE
  hex "Boot Stack Size"
  default 0x4000
  help
    Size of the boot-time stack used for kernel initialization

config RISCV64_SV39
  bool "Assume Sv39 Paging Support"
  default y

config RISCV64_SV48
  bool "Assume Sv48 Paging Support"
  default y

config RISCV64_SV57
  bool "Assume Sv57 Paging Support"
  default n

config RISCV64_SBI_DEBUG_CONSOLE
  bool "Use SBI Debug Console"
  default y

endmenu
```

## arch/x64/Kconfig
```kconfig
menu "x64 Options"
  depends on X64

config X64_KERNEL_LOAD_ADDR
  hex "Kernel Load Address"
  default 0x0
  help
    Physical Address the Kernel should be loaded at.

config X64_BOOT_STACK_SIZE
  hex "Boot Stack Size"
  default 0x4000
  help
    Size of the boot-time stack used for kernel initialization

config X64_PROT_MODE_TO_LONG_MODE
  bool "Protected Mode to Long Mode Support"
  default n
  help
    Include support for the transition from 32-bit protected mode to 64-bit long mode

choice
  prompt "Boot Method"
  default X64_MULTIBOOT2_BOOT
  config X64_MULTIBOOT2_BOOT
    select MULTIBOOT2
    select X64_PROT_MODE_TO_LONG_MODE
    bool "Multiboot2"
endchoice

config X64_IMPLEMENT_VMEM_DIRECTLY
  bool "Implement vmem Directly"
  default y
  select IMPLEMENT_VMEM_DIRECTLY
  help
    Provide implementation of vmem subsystem directly
    instead of using the paging subsystem.

config X64_ASSUME_2MB_PAGES
  bool "Assume Support for 2MB Pages"
  default n

config X64_ASSUME_1GB_PAGES
  bool "Assume Support for 1GB Pages"
  depends on X64_ASSUME_2MB_PAGES
  default n

config X64_BOOT_VGA
  bool "Use Early Platform VGA for printk"
  default y

config X64_BOOT_VGA_POST_LAUNCH
  bool "Keep Using Early Platform VGA for printk After Boot"
  default n
  depends on X64_BOOT_VGA

config X64_BOOT_SERIAL
  bool "Use Early Platform Serial Port for printk"
  default y

config X64_BOOT_SERIAL_POST_LAUNCH
  bool "Keep Using Early Serial Port for printk After Boot"
  default n
  depends on X64_BOOT_SERIAL

config X64_TEST_VOLATILITY_THREAD
  tristate "Debug Thread Volatility in Background Thread"
  default n

config X64_IGNORE_MADT_LAPIC
  bool "Ignore extra LAPIC found in MADT"
  default n

config X64_IGNORE_MADT_X2APIC
  bool "Ignore extra x2APIC found in MADT"
  default n

config X64_ENABLE_CALL_GATE_SYSCALL
  bool "Include Call Gate Syscall Support (WIP/Unimplemented)"
  default n
  depends on WIP

config X64_IGNORE_APIC_MSI
  bool "Disable Use of  LAPIC for PCI MSI/MSI-X"
  default n
  depends on PCI

endmenu
```

## drivers/Kconfig
```kconfig
menu "Block Devices"
source "drivers/blk/Kconfig"
endmenu

menu "Network Devices"
source "drivers/net/Kconfig"
endmenu

menu "Filesystems"
source "drivers/fs/Kconfig"
endmenu

menu "Clock Devices"
source "drivers/clk/Kconfig"
endmenu

menu "IRQ Devices"
source "drivers/irq/Kconfig"
endmenu

menu "Terminal Devices"
source "drivers/term/Kconfig"
endmenu

menu "Framebuffer Devices"
source "drivers/fb/Kconfig"
endmenu

menu "Randomness Sources"
source "drivers/rand/Kconfig"
endmenu

menu "Sound Devices"
source "drivers/snd/Kconfig"
endmenu

menu "PCI Options"
source "drivers/pci/Kconfig"
endmenu

menu "USB Options"
source "drivers/usb/Kconfig"
endmenu

source "drivers/ps2/Kconfig"
source "drivers/qemu/Kconfig"
source "drivers/virtio/Kconfig"

menu "VGA Options"
depends on PORT_IO
source "drivers/vga/Kconfig"
endmenu

menu "Linux Compatibility"
source "drivers/linux/Kconfig"
endmenu
```

## drivers/blk/Kconfig
```kconfig
config VIRTIO_BLK
    tristate "Virtio Block Device Driver"
    default y
    depends on VIRTIO
    help
      Include a driver for the virtio-blk device.

config VIRTIO_SCSI
    tristate "Virtio SCSI Device Driver"
    default y
    depends on VIRTIO && SCSI

config NVME
    tristate "NVME Driver"
    default y
    depends on PCI

config IDE
    bool "IDE Driver"
    default y

config LEGACY_IDE
    bool "Legacy IDE Discovery"
    default y
    depends on IDE && PORT_IO

config PCI_IDE
    bool "PCI IDE Discovery"
    default y
    depends on IDE && PCI

config AHCI
    tristate "AHCI Driver"
    depends on PCI
    default y
    depends on WIP
```

## drivers/fb/Kconfig
```kconfig
config VIRTIO_GPU_FB
    tristate "Virtio GPU Framebuffer Driver"
    default y
    depends on VIRTIO
    help
      Include a driver for the virtio-gpu device which presents a framebuffer interface.
```

## drivers/input/Kconfig
```kconfig
config USB_HID
    bool "USB Human Interface Driver"
    depends on USB
    default y

config PS2_KBD
    tristate "PS/2 Keyboard Driver"
    depends on PS2
    default y

config PS2_MOUSE
    tristate "PS/2 Mouse Driver"
    depends on PS2
    default y

config VIRTIO_INPUT
    tristate "Virtio Input Driver"
    depends on VIRTIO
    default y
```

## drivers/irq/Kconfig
```kconfig
config GICV2
    tristate "GICv2"
    default y
    depends on DEVICETREE && ARM64

config SIFIVE_PLIC
    tristate "SiFive PLIC"
    default y
    depends on DEVICETREE && RISCV64
    help
      Include a driver for the SiFive PLIC Interrupt Controller
```

## drivers/linux/Kconfig
```kconfig
config LINUX_DEVICETREE_CHOSEN
    bool "DeviceTree chosen Node Driver"
    depends on DEVICETREE
    default y
```

## drivers/net/Kconfig
```kconfig
config VIRTIO_NET
    tristate "Virtio Network Device Driver"
    default y
    depends on VIRTIO
    help
      Include a driver for the virtio-net device.
```

## drivers/pci/Kconfig
```kconfig
config PCI
    tristate "PCI Support"
    default y
    help
      Base PCI Bus Support

config PCI_ASSUME_CONTIGUOUS_DEVICES
    bool "Assume Contiguous Devices"
    depends on PCI
    default n
    help
      Assume PCI devices are contiguous within a bus, this is not required, but may speed up boot times by avoiding enumerating every possible bus:device:func.

config PCI_ALLOC_UNINITIALIZED_MMIO_BARS
    bool "Map Uninitialized MMIO BAR(s) Onto RAM"
    depends on PCI
    default n
    help
      If the kernel comes across an uninitialized MMIO BAR (physical address 0)
      then it will attempt to allocate physical memory and re-map the BAR to the memory

config POLLING_PCI_MAILBOX
    bool "Allow Polling for PCI MSI/MSI-X Interrupts"
    depends on PCI && WIP
    default n
    help
      Provide a polling implementation for the PCI mailbox
      subsystem incase a suitable IRQ-chip cannot be found
      in a system.

menu "PCI Configuration Space Access Mechanisms"
depends on PCI

config PCI_PORT_CAM
    bool "Port Configuration Access"
    depends on PORT_IO && PCI
    default y
    help
      Assume a PCI domain exists which can be accessed using the ports 0xCF8 and 0xCFC

config PCI_MMIO_ECAM
    bool "MMIO Enhanced Configuration Access"
    depends on PCI
    default y

config PCI_DEVTREE
    bool "Device Tree PCI Node"
    depends on DEVICETREE && PCI
    select PCI_MMIO_ECAM
    default y
    help
      Look for PCI domain nodes in the device tree

config PCIE_ACPI_MCFG
    bool "ACPI PCIe Discovery"
    depends on ACPI && PCI
    select PCI_MMIO_ECAM
    default y
    help
      Look for a MCFG ACPI table to discover PCIe Extended Configuration Access Mechanisms

endmenu

config DEBUG_LOG_PCI_BAR_ACCESSES
    bool "Debug Log PCI BAR Accesses"
    depends on PCI && DEBUGGING
    default n

config DEBUG_PCI_BAR_ACCESSES
    bool "Debug Bounds Check PCI BAR Accesses"
    depends on PCI && DEBUGGING
    default n
```

## drivers/ps2/Kconfig
```kconfig
config PS2
    tristate "PS/2 Support"
    default y
    help
      PS/2 Device Support

menu "PS/2 Controllers"
depends on PS2

config PS2_8042
    tristate "8042 PS/2 Controller"
    depends on PORT_IO && PS2
    default y

endmenu
```

## drivers/scsi/Kconfig
```kconfig
config SCSI
    tristate "SCSI Support"
    default y
    help
      Base SCSI Protocol Support
```

## drivers/serial/8250/Kconfig
```kconfig
config PC_COM_8250
    tristate "PC COM Serial Port(s)"
    default y
    depends on SERIAL_8250 && X64
    help
      Driver for platform serial ports on x64

config DEVTREE_8250
    tristate "Device Tree 8250 Driver"
    default y
    depends on DEVICETREE && SERIAL_8250
    help
      Driver for generic device tree 8250 devices
```

## drivers/snd/Kconfig
```kconfig
config VIRTIO_SND
    tristate "Virtio Sound Device Driver"
    default y
    depends on VIRTIO
    help
      Include a driver for the virtio-snd device.
```

## drivers/term/Kconfig
```kconfig
config SERIAL_8250
    tristate "8250 Based Serial UART(s)"
    default y
    help
      Framework to support 8250-based serial UART devices

config VIRTIO_CONSOLE
    bool "Virtio Console"
    default n
    depends on VIRTIO && WIP

config QEMU_SERIAL
    bool "QEMU PCI Serial"
    default n
    depends on PCI

source "drivers/term/8250/Kconfig"

config PL011_SERIAL
    bool "PL011 Serial"
    default n
    depends on DEVICETREE

config PL011_SERIAL_AT_BOOT
    bool "Use PL011 Serial at Boot"
    default n
    depends on PL011_SERIAL

config PL011_SERIAL_AT_BOOT_ADDR
    hex "PL011 Serial Boot Register Base"
    default 0x0
    depends on PL011_SERIAL_AT_BOOT
```

## drivers/timer/Kconfig
```kconfig
config ARM_CP15_TIMER
    tristate "ARM CP15 Local Timer"
    default y
    depends on ARM64 && DEVICETREE
```

## drivers/usb/Kconfig
```kconfig
config USB
    bool "USB Support"
    default y
    depends on WIP

config USB_XHCI
    bool "USB XHCI Support"
    default y
    depends on PCI && USB && WIP
```

## drivers/vga/Kconfig
```kconfig
menu "VGA Options"

config VGA
    bool "VGA Support"
    depends on PORT_IO

config LEGACY_VGA
    bool "Legacy VGA Support"
    depends on HAVE_LEGACY_VGA

config LEGACY_VGA_BASE_ADDRESS
    hex "Legacy VGA Base Address"
    depends on LEGACY_VGA
    default 0xB8000

config LEGACY_VGA_BOOT_PRINTK
    bool "Use Legacy VGA for Boot printk"
    depends on LEGACY_VGA
    default y

choice
    prompt "VGA Post-Launch Config"
    default VGA_FB

    config VGA_FB
        bool "Mode-setting Framebuffer Device"
        depends on VGA
    config VGA_LEGACY_TERMINAL
        bool "Legacy Terminal Device"
        depends on LEGACY_VGA
endchoice

config LEGACY_VGA_TERMINAL_PRINTK
    bool "Mirror printk to VGA Terminal Device Post-Launch"
    depends on VGA_LEGACY_TERMINAL && LEGACY_VGA_BOOT_PRINTK
    default y

config HAVE_LEGACY_VGA
    def_bool n

endmenu
```

## drivers/virtio/Kconfig
```kconfig
config VIRTIO
    tristate "Virtio Support"
    default y
    help
      Base Virtio Support

menu "Virtio Transports"
depends on VIRTIO

config VIRTIO_PCI
    bool "PCI"
    depends on PCI && VIRTIO
    default y

endmenu
```
